//51번 MOSI핀 52번 SCK핀
// Include application, user and local libraries
#include "SPI.h"
#include "TFT_22_ILI9225.h"
#include <OneWire.h>
#include <Wire.h>
#include "RTClib.h" 
#include <Stepper.h>
#include<SoftwareSerial.h>

#define relay1 22
#define relay2 23
#define relay3 24
#define relay4 25

SoftwareSerial BTSerial(12, 13);
static unsigned long dtime;
int dcount = 0;
int BT;
int month;
int dhour;
int tday = 0;
int hour = 0;
int year = 0;
int day = 0;
int day_ = 0;
int min = 0;
int lhour = 0;
int lmin = 0;
int min_ = 0;
int lmin_ = 0;
int maxtemp = 30;
int temp;
int mintemp = 10;
int time[5];
int time_[5];
char BT_;
int d = 0;

int DS18S20_Pin = 2;

int data = A1;
int heighval = 0;

OneWire ds(DS18S20_Pin);

Stepper step1(2048, 4, 5, 6, 7);       // 모터드라이버 8, 9, 10, 11번에 연결
int lap = 2048;

RTC_Millis rtc;

#define SensorPin A0
#define Offset 0.00
#define LED 13
#define samplingInterval 20
#define printInterval 800
#define ArrayLenth  40
int pHArray[ArrayLenth];
int pHArrayIndex = 0;

static unsigned long lcdTime = 0;
static unsigned long rtcTime = 0;

#define TFT_RST 8
#define TFT_RS  9
#define TFT_CS  10  // SS
#define TFT_SDI 51  // MOSI
#define TFT_CLK 52  // SCK
#define TFT_LED 3   // 0 if wired to +5V directly

// Use hardware SPI (faster - on Uno: 13-SCK, 12-MISO, 11-MOSI)
TFT_22_ILI9225 tft = TFT_22_ILI9225(TFT_RST, TFT_RS, TFT_CS, TFT_LED);
// Use software SPI (slower)
//TFT_22_ILI9225 tft = TFT_22_ILI9225(TFT_RST, TFT_RS, TFT_CS, TFT_SDI, TFT_CLK, TFT_LED);

// Variables and constants
uint16_t x, y;
boolean flag = false;

/*
   Tux black/white image in 180x220 converted using Ardafruit bitmap converter
   https://github.com/ehubin/Adafruit-GFX-Library/tree/master/Img2Code
*/
static const uint8_t PROGMEM tux[] =
{
  0xff, 0xff, 0xff, 0xff, 0xff, 0xff, 0xff, 0xff, 0xff, 0xff, 0xff, 0xff, 0xff, 0xff, 0xff, 0xff, 0xff, 0xff, 0xff, 0xff, 0xff, 0xff, 0xf0,
  0xff, 0xff, 0xff, 0xff, 0xff, 0xff, 0xff, 0xff, 0xff, 0xff, 0xff, 0xff, 0xff, 0xff, 0xff, 0xff, 0xff, 0xff, 0xff, 0xff, 0xff, 0xff, 0xf0,
  0xff, 0xff, 0xff, 0xff, 0xff, 0xff, 0xff, 0xff, 0xff, 0xff, 0xff, 0xff, 0xff, 0xff, 0xff, 0xff, 0xff, 0xff, 0xff, 0xff, 0xff, 0xff, 0xf0,
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  0xff, 0xff, 0xff, 0xff, 0xff, 0xff, 0xff, 0xff, 0xff, 0xff, 0xff, 0xff, 0xff, 0xff, 0xff, 0xff, 0xff, 0xff, 0xff, 0xff, 0xff, 0xff, 0xf0
};

// Setup
void setup() {
  pinMode(relay1, OUTPUT);
  pinMode(relay2, OUTPUT);
  pinMode(relay3, OUTPUT);
  pinMode(relay4, OUTPUT);
  tft.begin();
  Serial.begin(9600);
  pinMode(LED, OUTPUT);
  BTSerial.begin(9600);
  pinMode(8, OUTPUT);
  pinMode(9, OUTPUT);
  pinMode(10, OUTPUT);
  pinMode(11, OUTPUT);
  step1.setSpeed(18);
}

// Loop
void loop() {
  heighval = analogRead(data);
  DateTime now = rtc.now();
  float temperature = getTemp();
  Serial.println(temperature);
  static unsigned long samplingTime = millis();
  static unsigned long printTime = millis();
  static float pHValue, voltage;

  if (BTSerial.available()) {
    BTSerial.println("c=온도 t=시간 p=먹이 시간 l=조명시간 d=배수 주기");
    BT_ = BTSerial.read();
    while (BT_ == 'p') {
      for (int i = 0; i < 5; i++) {
        BTSerial.print(i + 1);
        BTSerial.println("번 쨰 먹이 줄 시간을 선택하세요");
        while (time[i] == 0) {
          time[i] = BTSerial.parseInt();
          if (time[i] > 24 || time[i] < 0) {
            BTSerial.println("시간을 다시 입력하세요");
            time[i] = 0;
          }
        }
      }
      if (time[4] != 0) {
        break;
      }
    }
    while (BT_ == 'c') {
      mintemp = 0; maxtemp = 0;
      BTSerial.println("최소 온도값을 입력 하세요");
      while (mintemp == 0) {
        mintemp = BTSerial.parseInt();
      }
      BTSerial.println("최대 온도값을 입력하세요");
      while (maxtemp == 0) {
        maxtemp = BTSerial.parseInt();
      }
    if (maxtemp != 0) {
      break;
    }
  }
  while (BT_ == 't') {
    hour = 0; min = 0; tday = 0; month = 0; year = 0;
    BTSerial.println("몇년 인지 입력 20**");
    while (year == 0) {
      year = BTSerial.parseInt();
    }
    BTSerial.println("몇월 인지 입력");
    while (month == 0) {
      month = BTSerial.parseInt();
    }
    BTSerial.println("몇일 인지 입력");
    while (tday == 0) {
      tday = BTSerial.parseInt();
    }
    BTSerial.println("몇시 인지 입력");
    while (hour == 0) {
      hour = BTSerial.parseInt();
    }
    BTSerial.println("몇분 인지 입력");
    while (min == 0) {
      min = BTSerial.parseInt();
    }
    DateTime now = rtc.now();
    rtc.begin(DateTime(year, month, tday, hour, min, 0));
    if (min != 0) {
      break;
    }
  }

  while (BT_ == 'l') {
    lhour = 0; lmin = 0;
    BTSerial.println("조명 키는 시간 입력");
    while (lhour == 0) {
      lhour = BTSerial.parseInt();
      if (lhour > 24 || lhour < 0) {
        lhour = 0;
        BTSerial.println("시간을 다시 입력하세요");
      }
    }
    BTSerial.println("조명 끄는 시간 입력");
    while (lmin == 0) {
      lmin = BTSerial.parseInt();
      if (lmin > 24 || lmin < 0) {
        lmin = 0;
        BTSerial.println("시간을 다시 입력하세요");
      }
    }
    if (lmin != 0) {
      break;
    }
  }
  while (BT_ == 'd') {
    day = 0; dhour = 0;
    BTSerial.println("배수 주기 입력 (일)");
    while (day == 0) {
      day = BTSerial.parseInt();
    }
    day_ = day + now.day();
    BTSerial.println("배수 시간 입력");
    while (dhour == 0) {
      dhour = BTSerial.parseInt();
      if (dhour > 24 || dhour < 0) {
        dhour = 0;
        BTSerial.println("시간을 다시 입력하세요");
      }
    }
    if (dhour != 0) {
      break;
    }
  }
}

if (millis() - samplingTime > samplingInterval)
{
  pHArray[pHArrayIndex++] = analogRead(SensorPin);
  if (pHArrayIndex == ArrayLenth)pHArrayIndex = 0;
  voltage = avergearray(pHArray, ArrayLenth) * 5.0 / 1024;
  pHValue = 3.5 * voltage + Offset;
  samplingTime = millis();
}
if (millis() - printTime > printInterval)
{
  Serial.print("    pH value: ");
  Serial.println(pHValue, 2);
  digitalWrite(LED, digitalRead(LED) ^ 1);
  printTime = millis();
}

if (now.day() == day_&& now.hour() == dhour && dcount <=1) {
  digitalWrite(relay4, LOW);
  if (dcount == 0) {
    BTSerial.println("배수 시작");
    dtime = millis();
  }
  dcount = 1;
  if (millis()-dtime > 2000) {
    BTSerial.println("배수 종료");
    digitalWrite(relay4, HIGH);
    dcount = 2;
  }
}
if (dhour + 1 <= now.hour()&&dcount==2) {
  dcount = 0;
}

if (now.hour() == lhour) {
  digitalWrite(relay3, LOW);
}
else if (now.hour() == lmin) {
  digitalWrite(relay3, HIGH);
}

if (heighval > 500) {
  digitalWrite(relay1, LOW);
}

if (1 > pHValue || pHValue > 10) {
  BTSerial.println("수질 오염");
}

if (temperature < mintemp || temperature > maxtemp) {
  digitalWrite(relay2, LOW);
}
else  digitalWrite(relay2, HIGH);

for (int i = 0; i < 5; i++) {
  if (now.hour() == time[i] && now.minute() == 0 && time_[i] == 0) {
    time_[i] = 1;
    step1.step(lap);
    delay(1000);
    step1.step(-lap);
    delay(1000);
    if (i - 1 >= 0) {
      time_[i - 1] = 0;
    }
    else if (i - 1 == -1) {
      time_[4] = 0;
    }
  }
}

if (lcdTime + 1000 < millis()) {
  lcdTime = millis();
  tft.clear();
  tft.setOrientation(1);
  tft.setFont(Terminal6x8);
  tft.drawText(10, 10, " PH : ");
  tft.drawText(40, 10, (String)pHValue);
  tft.drawText(10, 20, " temp : ");
  tft.drawText(50, 20, (String)temperature);
}
}

double avergearray(int* arr, int number) {
  int i;
  int max, min;
  double avg;
  long amount = 0;
  if (number <= 0) {
    Serial.println("Error number for the array to avraging!/n");
    return 0;
  }
  if (number < 5) {
    for (i = 0; i < number; i++) {
      amount += arr[i];
    }
    avg = amount / number;
    return avg;
  } else {
    if (arr[0] < arr[1]) {
      min = arr[0]; max = arr[1];
    }
    else {
      min = arr[1]; max = arr[0];
    }
    for (i = 2; i < number; i++) {
      if (arr[i] < min) {
        amount += min;
        min = arr[i];
      } else {
        if (arr[i] > max) {
          amount += max;
          max = arr[i];
        } else {
          amount += arr[i];
        }
      }
    }
    avg = (double)amount / (number - 2);
  }
  return avg;
}

float getTemp() {

  byte data[12];
  byte addr[8];

  if ( !ds.search(addr)) {
    ds.reset_search();
    return -1000;
  }
  if ( OneWire::crc8( addr, 7) != addr[7]) {
    Serial.println("CRC is not valid!");
    return -1000;
  }
  if ( addr[0] != 0x10 && addr[0] != 0x28) {
    Serial.print("Device is not recognized");
    return -1000;
  }

  ds.reset();
  ds.select(addr);
  ds.write(0x44, 1);
  byte present = ds.reset();
  ds.select(addr);
  ds.write(0xBE);

  for (int i = 0; i < 9; i++) {
    data[i] = ds.read();
  }

  ds.reset_search();
  byte MSB = data[1];
  byte LSB = data[0];
  float tempRead = ((MSB << 8) | LSB);
  float TemperatureSum = tempRead / 16;
  return TemperatureSum;
}
